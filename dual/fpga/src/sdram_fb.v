// SDRAM frame-buffer controller for the Tang SDRAM module (W9825G6KH,
// 4 banks x 8192 rows x 512 columns x 16 bit).
//
// The only operations are whole video lines of 640 words, moved as five
// full-page bursts of 128 words, each opened with ACTIVE and closed with
// PRECHARGE:
//   - two write ports (one per receiver): line buffer -> SDRAM
//   - one read port (display): SDRAM -> display line buffer
// Priority: refresh, then read, then the write ports in turn.
//
// Word address (22 bit): {ch, buf[1:0], line[8:0], col[9:0]}; a line starts on
// a 1024-word boundary.  SDRAM column = addr[8:0], row = addr[21:9], bank 0.
//
// Clocking: the controller runs on clk (75 MHz).  The SDRAM clock is clk
// inverted (generated by an ODDR in the top level), so commands and write
// data launched on a rising edge are sampled half a period later.  Read data
// is captured on the falling edge of clk (= SDRAM rising edge, which is when
// the previous word is still held for tOH) and re-registered on the rising
// edge.  With CAS latency 2 the first word is in dq_in from the 4th rising
// edge after the READ command; RD_TAP aligns the data-valid flag with it and
// is the knob to turn if the board delays turn out different.
module sdram_fb #(
    parameter CLK_HZ       = 75_000_000,
    parameter integer RD_TAP = 3
) (
    input  wire        clk,
    input  wire        rst,

    // write ports
    input  wire        w0_req,
    input  wire [21:0] w0_base,
    output reg         w0_ack,
    input  wire [15:0] w0_data,
    input  wire        w1_req,
    input  wire [21:0] w1_base,
    output reg         w1_ack,
    input  wire [15:0] w1_data,
    output reg  [9:0]  w_idx,        // word index the write ports must present next cycle

    // read port
    input  wire        r_req,        // hold until r_take
    input  wire [21:0] r_base,
    output reg         r_take,       // request accepted
    output reg         r_ack,        // last word delivered
    output reg         r_we,
    output reg  [9:0]  r_idx,
    output reg  [15:0] r_data,

    // SDRAM pins
    output reg         sd_cs_n,
    output reg         sd_ras_n,
    output reg         sd_cas_n,
    output reg         sd_we_n,
    output reg  [12:0] sd_a,
    output reg  [1:0]  sd_ba,
    output reg  [1:0]  sd_dqm,
    output reg  [15:0] sd_dq_o,
    output reg         sd_dq_oe,
    input  wire [15:0] sd_dq_i
);

    localparam integer INIT_CYC = CLK_HZ / 1000 * 210 / 1000;   // 210 us
    localparam integer REF_CYC  = CLK_HZ / 1000 * 75 / 10000;   // 7.5 us
    localparam [3:0] T_RP  = 4'd2;
    localparam [3:0] T_RCD = 4'd2;
    localparam [3:0] T_RFC = 4'd6;
    localparam [3:0] T_MRD = 4'd3;
    localparam [7:0] BL    = 8'd128;
    localparam [2:0] NBURST = 3'd5;

    // commands {ras, cas, we}
    localparam [2:0] C_NOP = 3'b111, C_ACT = 3'b011, C_RD = 3'b101, C_WR = 3'b100,
                     C_BST = 3'b110, C_PRE = 3'b010, C_REF = 3'b001, C_MRS = 3'b000;

    localparam [3:0] S_INIT = 4'd0, S_IPRE = 4'd1, S_IREF = 4'd2, S_IMRS = 4'd3,
                     S_IDLE = 4'd4, S_WAIT = 4'd5, S_ACT = 4'd6, S_WR = 4'd7,
                     S_WEND = 4'd8, S_RD = 4'd9;

    reg [3:0]  state;
    reg [15:0] tcnt;
    reg [3:0]  irefs;
    reg [15:0] refcnt;
    reg        ref_req;

    reg        busy;
    reg [1:0]  cur;          // 0: write port 0, 1: write port 1, 2: read port
    reg        wturn;        // round robin between write ports
    reg [21:0] base;
    reg [2:0]  bidx;
    reg [7:0]  k;

    wire [21:0] baddr = base + {12'd0, bidx, 7'd0};

    task cmd(input [2:0] c);
        begin
            sd_cs_n  <= 1'b0;
            {sd_ras_n, sd_cas_n, sd_we_n} <= c;
        end
    endtask

    // read data capture
    reg [15:0] dq_neg, dq_in;
    always @(negedge clk) dq_neg <= sd_dq_i;
    always @(posedge clk) dq_in  <= dq_neg;

    reg [RD_TAP:0] rflag;
    reg            rd_issue;
    reg [9:0]      r_cnt;

    always @(posedge clk) begin
        w0_ack <= 1'b0;
        w1_ack <= 1'b0;
        r_take <= 1'b0;
        rd_issue <= 1'b0;

        if (rst) begin
            state   <= S_INIT;
            tcnt    <= 16'd0;
            refcnt  <= 16'd0;
            ref_req <= 1'b0;
            busy    <= 1'b0;
            wturn   <= 1'b0;
            sd_cs_n <= 1'b1;
            {sd_ras_n, sd_cas_n, sd_we_n} <= C_NOP;
            sd_dqm  <= 2'b11;
            sd_dq_oe <= 1'b0;
            sd_a    <= 13'd0;
            sd_ba   <= 2'd0;
            w_idx   <= 10'd0;
        end else begin
            cmd(C_NOP);
            if (refcnt == REF_CYC[15:0]) begin
                refcnt  <= 16'd0;
                ref_req <= 1'b1;
            end else
                refcnt <= refcnt + 16'd1;

            case (state)
            // ---------------- initialisation ----------------
            S_INIT: begin
                sd_cs_n <= 1'b1;
                if (tcnt == INIT_CYC[15:0]) begin
                    cmd(C_PRE);
                    sd_a[10] <= 1'b1;          // all banks
                    tcnt  <= 16'd0;
                    state <= S_IPRE;
                end else
                    tcnt <= tcnt + 16'd1;
            end
            S_IPRE: begin
                if (tcnt == {12'd0, T_RP}) begin
                    tcnt  <= 16'd0;
                    irefs <= 4'd0;
                    state <= S_IREF;
                end else tcnt <= tcnt + 16'd1;
            end
            S_IREF: begin
                if (tcnt == 16'd0) begin
                    cmd(C_REF);
                    tcnt <= 16'd1;
                end else if (tcnt == {12'd0, T_RFC}) begin
                    tcnt  <= 16'd0;
                    irefs <= irefs + 4'd1;
                    if (irefs == 4'd7) state <= S_IMRS;
                end else tcnt <= tcnt + 16'd1;
            end
            S_IMRS: begin
                if (tcnt == 16'd0) begin
                    cmd(C_MRS);
                    sd_ba <= 2'b00;
                    // burst write = programmed, CL = 2, sequential, full page
                    sd_a  <= 13'b000_0_00_010_0_111;
                    tcnt  <= 16'd1;
                end else if (tcnt == {12'd0, T_MRD}) begin
                    tcnt  <= 16'd0;
                    state <= S_IDLE;
                end else tcnt <= tcnt + 16'd1;
            end

            // ---------------- normal operation ----------------
            S_WAIT: begin
                if (tcnt == 16'd0) state <= S_IDLE;
                else tcnt <= tcnt - 16'd1;
            end
            S_IDLE: begin
                if (ref_req) begin
                    cmd(C_REF);
                    ref_req <= 1'b0;
                    tcnt    <= {12'd0, T_RFC} - 16'd2;
                    state   <= S_WAIT;
                end else if (busy || r_req || w0_req || w1_req) begin
                    if (!busy) begin
                        busy <= 1'b1;
                        bidx <= 3'd0;
                        if (r_req) begin
                            cur <= 2'd2; base <= r_base; r_take <= 1'b1;
                        end else if (w0_req && (!w1_req || !wturn)) begin
                            cur <= 2'd0; base <= w0_base; wturn <= 1'b1;
                        end else begin
                            cur <= 2'd1; base <= w1_base; wturn <= 1'b0;
                        end
                        state <= S_IDLE;           // open the row next cycle
                    end else begin
                        cmd(C_ACT);
                        sd_ba <= 2'b00;
                        sd_a  <= baddr[21:9];
                        w_idx <= {bidx, 7'd0};     // write ports: word 0 of this burst
                        tcnt  <= {12'd0, T_RCD} - 16'd2;
                        state <= S_ACT;
                    end
                end
            end
            S_ACT: begin
                // NOP for tRCD; w_idx advances so that word 0 is on the port
                // data inputs on the cycle the WRITE command is registered
                if (tcnt == 16'd0) begin
                    k     <= 8'd0;
                    state <= (cur == 2'd2) ? S_RD : S_WR;
                    if (cur != 2'd2) w_idx <= w_idx + 10'd1;
                end else tcnt <= tcnt - 16'd1;
            end
            S_WR: begin
                if (k == 8'd0) begin
                    cmd(C_WR);
                    sd_a  <= {4'b0000, baddr[8:0]};
                end
                sd_dq_oe <= 1'b1;
                sd_dqm   <= 2'b00;
                sd_dq_o  <= (cur == 2'd0) ? w0_data : w1_data;
                w_idx    <= w_idx + 10'd1;
                k        <= k + 8'd1;
                if (k == BL - 8'd1) state <= S_WEND;
            end
            S_WEND: begin
                // mask the word that the full-page burst would write next,
                // then precharge (tWR = 2 clocks after the last data)
                if (k == BL) begin
                    sd_dqm   <= 2'b11;
                    sd_dq_oe <= 1'b0;
                    k        <= k + 8'd1;
                end else begin
                    cmd(C_PRE);
                    sd_a[10] <= 1'b0;
                    finish_burst();
                end
            end
            S_RD: begin
                if (k == 8'd0) begin
                    cmd(C_RD);
                    sd_a  <= {4'b0000, baddr[8:0]};
                    sd_dqm <= 2'b00;
                end
                rd_issue <= 1'b1;
                k <= k + 8'd1;
                if (k == BL - 8'd1) begin
                    state <= S_WEND;     // reused: next cycle precharges
                    k     <= BL + 8'd1;  // skip the masking cycle
                end
            end
            default: state <= S_IDLE;
            endcase
        end
    end

    task finish_burst;
        begin
            tcnt <= {12'd0, T_RP} - 16'd1;
            state <= S_WAIT;
            if (bidx == NBURST - 3'd1) begin
                busy <= 1'b0;
                if (cur == 2'd0) w0_ack <= 1'b1;
                if (cur == 2'd1) w1_ack <= 1'b1;
            end else
                bidx <= bidx + 3'd1;
        end
    endtask

    // read data to the display line buffer; the job is acknowledged when the
    // last word has arrived
    always @(posedge clk) begin
        r_we  <= 1'b0;
        r_ack <= 1'b0;
        if (rst) begin
            rflag <= 0;
            r_cnt <= 10'd0;
        end else begin
            rflag <= {rflag[RD_TAP-1:0], rd_issue};
            if (rflag[RD_TAP]) begin
                r_we   <= 1'b1;
                r_idx  <= r_cnt;
                r_data <= dq_in;
                if (r_cnt == 10'd639) begin
                    r_cnt <= 10'd0;
                    r_ack <= 1'b1;
                end else
                    r_cnt <= r_cnt + 10'd1;
            end
        end
    end

endmodule
